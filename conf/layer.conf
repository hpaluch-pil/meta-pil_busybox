## conf/layer.conf
```bitbake
# We have a conf and classes directory, add to BBPATH
BBPATH .= ":${LAYERDIR}"

# We have recipes-* directories, add to BBFILES
BBFILES += "${LAYERDIR}/recipes-*/*/*.bb \
            ${LAYERDIR}/recipes-*/*/*.bbappend"

BBFILE_COLLECTIONS += "meta-pil_busybox"
BBFILE_PATTERN_meta-pil_busybox = "^${LAYERDIR}/"
BBFILE_PRIORITY_meta-pil_busybox = "6"

LAYERDEPENDS_meta-pil_busybox = "core"
LAYERSERIES_COMPAT_meta-pil_busybox = "dunfell"
```
